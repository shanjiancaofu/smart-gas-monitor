#include "gas_board.h"
#include <string.h>

static GPIO_PinState opposite(GPIO_PinState level)
{
    return level == GPIO_PIN_SET ? GPIO_PIN_RESET : GPIO_PIN_SET;
}
void gas_board_close(void)
{
    HAL_GPIO_WritePin(GPIOA, GPIO_PIN_8, opposite(GAS_RELAY_OPEN_LEVEL));
    HAL_GPIO_WritePin(GPIOA, GPIO_PIN_5, GPIO_PIN_RESET);
}
bool gas_board_init(gas_board_t *b, ADC_HandleTypeDef *adc, I2C_HandleTypeDef *eeprom)
{
    memset(b, 0, sizeof(*b)); b->adc = adc; b->eeprom = eeprom;
    /* GPIO clocks/modes and initial levels are generated by CubeMX. */
    gas_board_close();
    HAL_GPIO_WritePin(GPIOA, GPIO_PIN_7, opposite(GAS_BUZZER_ON_LEVEL));
    HAL_GPIO_WritePin(GPIOA, GPIO_PIN_6, GPIO_PIN_RESET);
    HAL_GPIO_WritePin(GPIOB, GPIO_PIN_8 | GPIO_PIN_9, GPIO_PIN_RESET);
    /* A held key at startup must be released before it can confirm. */
    b->key_raw = (uint8_t)((~GPIOB->IDR >> 12) & 15u);
    b->key_stable = b->key_raw;
    return HAL_ADCEx_Calibration_Start(adc) == HAL_OK;
}
bool gas_board_sample(gas_board_t *b, uint16_t values[3])
{
    static const uint32_t channels[] = {ADC_CHANNEL_0, ADC_CHANNEL_1, ADC_CHANNEL_4};
    ADC_ChannelConfTypeDef config = {0};
    unsigned i;
    config.Rank = ADC_REGULAR_RANK_1;
    config.SamplingTime = ADC_SAMPLETIME_239CYCLES_5;
    for (i = 0; i < 3; ++i) {
        config.Channel = channels[i];
        if (HAL_ADC_ConfigChannel(b->adc, &config) != HAL_OK ||
            HAL_ADC_Start(b->adc) != HAL_OK ||
            HAL_ADC_PollForConversion(b->adc, 5) != HAL_OK) {
            (void)HAL_ADC_Stop(b->adc); return false;
        }
        values[i] = (uint16_t)HAL_ADC_GetValue(b->adc);
        if (HAL_ADC_Stop(b->adc) != HAL_OK) return false;
    }
    return true;
}
void gas_board_outputs(bool open, bool green, bool yellow, bool alarm)
{
    /* Apply valve decision before the indicators or any slow I/O. */
    HAL_GPIO_WritePin(GPIOA, GPIO_PIN_8, open ? GAS_RELAY_OPEN_LEVEL : opposite(GAS_RELAY_OPEN_LEVEL));
    HAL_GPIO_WritePin(GPIOA, GPIO_PIN_5, open ? GPIO_PIN_SET : GPIO_PIN_RESET);
    HAL_GPIO_WritePin(GPIOA, GPIO_PIN_6, alarm ? GPIO_PIN_SET : GPIO_PIN_RESET);
    HAL_GPIO_WritePin(GPIOA, GPIO_PIN_7, alarm ? GAS_BUZZER_ON_LEVEL : opposite(GAS_BUZZER_ON_LEVEL));
    HAL_GPIO_WritePin(GPIOB, GPIO_PIN_8, green ? GPIO_PIN_SET : GPIO_PIN_RESET);
    HAL_GPIO_WritePin(GPIOB, GPIO_PIN_9, yellow ? GPIO_PIN_SET : GPIO_PIN_RESET);
}
uint8_t gas_board_keys(gas_board_t *b, uint32_t now)
{
    uint8_t raw = (uint8_t)((~GPIOB->IDR >> 12) & 15u), events = 0;
    unsigned i;
    for (i = 0; i < 4; ++i) {
        uint8_t mask = (uint8_t)(1u << i);
        if ((raw & mask) != (b->key_raw & mask)) {
            b->key_raw ^= mask; b->key_changed[i] = now;
        }
        if ((raw & mask) != (b->key_stable & mask) &&
            (uint32_t)(now - b->key_changed[i]) >= 30u) {
            b->key_stable ^= mask;
            if (raw & mask) events |= mask;
        }
    }
    return events;
}
bool gas_board_eeprom_read(void *context, uint16_t address, uint8_t *data, size_t size)
{
    gas_board_t *b = context;
    if (address >= 256u || size > 256u - address) return false;
    return HAL_I2C_Mem_Read(b->eeprom, GAS_EEPROM_ADDRESS, address,
        I2C_MEMADD_SIZE_8BIT, data, (uint16_t)size, 10) == HAL_OK;
}
bool gas_board_eeprom_write(void *context, uint16_t address, const uint8_t *data, size_t size)
{
    gas_board_t *b = context;
    if (address >= 256u || size > 256u - address) return false;
    while (size != 0) {
        /* AT24C02 page size is 8 bytes; never wrap inside a page. */
        size_t count = 8u - (address % 8u);
        if (count > size) count = size;
        if (HAL_I2C_Mem_Write(b->eeprom, GAS_EEPROM_ADDRESS, address,
            I2C_MEMADD_SIZE_8BIT, (uint8_t *)data, (uint16_t)count, 10) != HAL_OK ||
            HAL_I2C_IsDeviceReady(b->eeprom, GAS_EEPROM_ADDRESS, 10, 1) != HAL_OK) return false;
        address = (uint16_t)(address + count); data += count; size -= count;
    }
    return true;
}
