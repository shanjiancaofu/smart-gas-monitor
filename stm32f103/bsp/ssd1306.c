#include "ssd1306.h"
#include <stdarg.h>
#include <stdio.h>
#include <string.h>

/* I2C control bytes: 0x00 prefixes a command stream, 0x40 pixel data. */
#define SSD1306_CMD  0x00u
#define SSD1306_DATA 0x40u

/* Blocking transfers are bounded so a missing panel cannot hang the superloop. */
#define SSD1306_TIMEOUT 100u

#define SSD1306_CHAR_FIRST 32u
#define SSD1306_CHAR_COUNT 95u

/* ASCII 32..126, column-major, bit 0 is the top pixel of the page. Generated
 * from a monospace face; regenerate rather than hand-editing. */
static const uint8_t font6x8[SSD1306_CHAR_COUNT][6] = {
    { 0x00, 0x00, 0x00, 0x00, 0x00, 0x00 },
    { 0x00, 0x00, 0x00, 0x2F, 0x00, 0x00 },
    { 0x00, 0x00, 0x03, 0x00, 0x03, 0x00 },
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    { 0x18, 0x08, 0x10, 0x18, 0x00, 0x00 },
};

static const uint8_t font8x16[SSD1306_CHAR_COUNT][16] = {
    { 0x00, 0x00, 0x00, 0x00, 0x00, 0x00, 0x00, 0x00, 0x00, 0x00, 0x00, 0x00, 0x00, 0x00, 0x00, 0x00 },
    { 0x00, 0x00, 0x00, 0x00, 0xFE, 0x0D, 0x00, 0x0C, 0x00, 0x00, 0x00, 0x00, 0x00, 0x00, 0x00, 0x00 },
    { 0x00, 0x00, 0x1E, 0x00, 0x1E, 0x00, 0x00, 0x00, 0x1E, 0x00, 0x1E, 0x00, 0x00, 0x00, 0x00, 0x00 },
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    { 0x80, 0x01, 0x40, 0x00, 0x40, 0x00, 0xC0, 0x00, 0x80, 0x01, 0x00, 0x01, 0x00, 0x01, 0xC0, 0x00 },
};

/* Horizontal addressing, 128x64, charge pump on, not mirrored. */
static const uint8_t init_sequence[] = {
    0xAE,        /* display off while configuring */
    0x20, 0x00,  /* horizontal addressing mode */
    0xB0,        /* start at page 0 */
    0xC8,        /* COM scan direction remapped */
    0x00, 0x10,  /* column 0 */
    0x40,        /* display start line 0 */
    0x81, 0x7F,  /* contrast */
    0xA1,        /* segment remap */
    0xA6,        /* normal, not inverted */
    0xA8, 0x3F,  /* multiplex ratio 1/64 */
    0xA4,        /* output follows RAM */
    0xD3, 0x00,  /* no vertical offset */
    0xD5, 0x80,  /* clock divide and oscillator */
    0xD9, 0xF1,  /* pre-charge period */
    0xDA, 0x12,  /* COM pins, 128x64 wiring */
    0xDB, 0x40,  /* VCOMH deselect */
    0x8D, 0x14,  /* charge pump on */
    0xAF         /* display on */
};

/* HAL takes a non-const pointer but only reads from it. */
static bool command_list(ssd1306_t *oled, const uint8_t *commands, unsigned count)
{
    return HAL_I2C_Mem_Write(oled->i2c, SSD1306_I2C_ADDR, SSD1306_CMD,
                             I2C_MEMADD_SIZE_8BIT, (uint8_t *)commands,
                             (uint16_t)count, SSD1306_TIMEOUT) == HAL_OK;
}

bool ssd1306_init(ssd1306_t *oled, I2C_HandleTypeDef *i2c)
{
    memset(oled, 0, sizeof(*oled));
    oled->i2c = i2c;
    if (!command_list(oled, init_sequence, sizeof(init_sequence))) return false;
    ssd1306_clear(oled);
    ssd1306_flush(oled);
    return true;
}

void ssd1306_clear(ssd1306_t *oled)
{
    memset(oled->buffer, 0, sizeof(oled->buffer));
    /* Everything changed, so mark every page. */
    oled->dirty = 0xFFu;
}

void ssd1306_flush(ssd1306_t *oled)
{
    unsigned page;
    for (page = 0; page < SSD1306_PAGES; ++page) {
        uint8_t setup[3];
        if (!(oled->dirty & (1u << page))) continue;
        /* Position the write pointer, then stream the page in one transfer. */
        setup[0] = (uint8_t)(0xB0u | page);
        setup[1] = 0x00;  /* column low nibble */
        setup[2] = 0x10;  /* column high nibble */
        if (!command_list(oled, setup, sizeof(setup))) return;
        if (HAL_I2C_Mem_Write(oled->i2c, SSD1306_I2C_ADDR, SSD1306_DATA,
                              I2C_MEMADD_SIZE_8BIT,
                              &oled->buffer[page * SSD1306_WIDTH], SSD1306_WIDTH,
                              SSD1306_TIMEOUT) != HAL_OK) return;
        /* Only clear the flag once the page really went out. */
        oled->dirty &= (uint8_t)~(1u << page);
    }
}

static void draw_char(ssd1306_t *oled, unsigned x, unsigned page, char ch,
                      bool large)
{
    unsigned width = large ? SSD1306_LARGE_W : SSD1306_SMALL_W;
    unsigned pages = large ? 2u : 1u;
    const uint8_t *glyph;
    unsigned i, p;

    if ((unsigned char)ch < SSD1306_CHAR_FIRST ||
        (unsigned char)ch >= SSD1306_CHAR_FIRST + SSD1306_CHAR_COUNT)
        ch = '?';
    glyph = large ? font8x16[(unsigned char)ch - SSD1306_CHAR_FIRST]
                  : font6x8[(unsigned char)ch - SSD1306_CHAR_FIRST];

    for (i = 0; i < width; ++i)
        for (p = 0; p < pages; ++p)
            oled->buffer[(page + p) * SSD1306_WIDTH + x + i] = glyph[p * width + i];
    oled->dirty |= (uint8_t)(((1u << pages) - 1u) << page);
}

bool ssd1306_text(ssd1306_t *oled, unsigned x, unsigned page, const char *text,
                  bool large)
{
    unsigned width = large ? SSD1306_LARGE_W : SSD1306_SMALL_W;
    unsigned pages = large ? 2u : 1u;
    unsigned length = (unsigned)strlen(text);
    unsigned i;

    /* All or nothing: a half-drawn line is worse than none. */
    if (x + length * width > SSD1306_WIDTH || page + pages > SSD1306_PAGES)
        return false;
    for (i = 0; i < length; ++i)
        draw_char(oled, x + i * width, page, text[i], large);
    return true;
}

bool ssd1306_textf(ssd1306_t *oled, unsigned x, unsigned page, bool large,
                   const char *format, ...)
{
    /* Longest line that can fit is 21 small characters plus the terminator. */
    char line[24];
    va_list args;
    va_start(args, format);
    (void)vsnprintf(line, sizeof(line), format, args);
    va_end(args);
    return ssd1306_text(oled, x, page, line, large);
}
