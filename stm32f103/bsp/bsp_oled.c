#include "bsp_oled.h"
#include "bsp_i2c.h"
#include <stdarg.h>
#include <stdio.h>
#include <string.h>

/* I2C 控制字节：0x00 后面跟命令流，0x40 后面跟像素数据。 */
#define SSD1306_CMD 0x00u
#define SSD1306_DATA 0x40u

/* 阻塞传输都有超时上限，面板不在线也不会把主循环卡死。 */
#define SSD1306_TIMEOUT 100u

#define SSD1306_CHAR_FIRST 32u
#define SSD1306_CHAR_COUNT 95u

/* font6x8: ASCII 32..126，列优先，bit 0 是 page 里最上面那个像素。
 * 取自参考工程的标准库字模，由 tools/gen_oled_font.py 生成，不要手工编辑。 */
static const uint8_t font6x8[SSD1306_CHAR_COUNT][6] = {
    {0x00, 0x00, 0x00, 0x00, 0x00, 0x00}, /* ' ' */
    {0x00, 0x00, 0x00, 0x2F, 0x00, 0x00}, /* '!' */
    {0x00, 0x00, 0x07, 0x00, 0x07, 0x00}, /* '"' */
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    {0x00, 0x00, 0x00, 0x00, 0x00, 0x00} /* '~' */
};

/* font8x16: ASCII 32..126，列优先，bit 0 是 page 里最上面那个像素。
 * 取自参考工程的标准库字模，由 tools/gen_oled_font.py 生成，不要手工编辑。 */
static const uint8_t font8x16[SSD1306_CHAR_COUNT][16] = {
    {0x00, 0x00, 0x00, 0x00, 0x00, 0x00, 0x00, 0x00, 0x00, 0x00, 0x00, 0x00, 0x00, 0x00, 0x00, 0x00}, /* ' ' */
    {0x00, 0x00, 0x00, 0xF8, 0x00, 0x00, 0x00, 0x00, 0x00, 0x00, 0x00, 0x33, 0x30, 0x00, 0x00, 0x00}, /* '!' */
    {0x00, 0x10, 0x0C, 0x06, 0x10, 0x0C, 0x06, 0x00, 0x00, 0x00, 0x00, 0x00, 0x00, 0x00, 0x00, 0x00}, /* '"' */
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    {0x00, 0x06, 0x01, 0x01, 0x02, 0x02, 0x04, 0x04, 0x00, 0x00, 0x00, 0x00, 0x00, 0x00, 0x00, 0x00} /* '~' */
};

/* 水平寻址、128x64、打开电荷泵、整体不做镜像。 */
static const uint8_t init_sequence[] = {
    0xAE,       /* 配置期间先关显示 */
    0x20, 0x02, /* Page addressing mode; refresh uses B0..B7 page commands. */
    0xB0,       /* 从 page 0 开始 */
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    0x8D, 0x14, /* 打开电荷泵 */
    0xAF        /* 打开显示 */
};

/* HAL 接口要的是非 const 指针，但它只读不写。 */
static bool command_list(bsp_oled_t *oled, const uint8_t *commands, unsigned count)
{
    return bsp_i2c_write(oled->i2c, SSD1306_I2C_ADDR, SSD1306_CMD, 8u, commands, (uint16_t)count,
                         SSD1306_TIMEOUT);
}

bool bsp_oled_init(bsp_oled_t *oled, I2C_HandleTypeDef *i2c)
{
    memset(oled, 0, sizeof(*oled));
    oled->i2c = i2c;
    /* 失败时提前返回，ready 保持 memset 清零的状态。 */
    if (!command_list(oled, init_sequence, sizeof(init_sequence))) {
        return false;
    }
    bsp_oled_clear(oled);
    bsp_oled_flush(oled);
    oled->ready = true;
    return true;
}

bool bsp_oled_is_ready(const bsp_oled_t *oled)
{
    return oled->ready;
}

void bsp_oled_clear(bsp_oled_t *oled)
{
    memset(oled->buffer, 0, sizeof(oled->buffer));
    /* 全部内容都变了，所以每个 page 都要标记为待刷新。 */
    oled->dirty = 0xFFu;
}

void bsp_oled_flush(bsp_oled_t *oled)
{
    unsigned page;
    for (page = 0; page < SSD1306_PAGES; ++page) {
        uint8_t setup[3];
        if (!(oled->dirty & (1u << page))) {
            continue;
        }
        /* 先把写指针定位好，再用一次传输把整页发出去。 */
        setup[0] = (uint8_t)(0xB0u | page);
        setup[1] = 0x00; /* 列地址低半字节 */
        setup[2] = 0x10; /* 列地址高半字节 */
        if (!command_list(oled, setup, sizeof(setup))) {
            return;
        }
        if (!bsp_i2c_write(oled->i2c, SSD1306_I2C_ADDR, SSD1306_DATA, 8u,
                           &oled->buffer[page * SSD1306_WIDTH], SSD1306_WIDTH, SSD1306_TIMEOUT)) {
            return;
        }
        /* 只有这一页真的发出去了，才清掉标志位。 */
        oled->dirty &= (uint8_t) ~(1u << page);
    }
}

static void draw_char(bsp_oled_t *oled, unsigned x, unsigned page, char ch, bool large)
{
    unsigned width = large ? SSD1306_LARGE_W : SSD1306_SMALL_W;
    unsigned pages = large ? 2u : 1u;
    const uint8_t *glyph;
    unsigned i, p;

    if ((unsigned char)ch < SSD1306_CHAR_FIRST ||
        (unsigned char)ch >= SSD1306_CHAR_FIRST + SSD1306_CHAR_COUNT) {
        ch = '?';
    }
    glyph = large ? font8x16[(unsigned char)ch - SSD1306_CHAR_FIRST]
                  : font6x8[(unsigned char)ch - SSD1306_CHAR_FIRST];

    for (i = 0; i < width; ++i) {
        for (p = 0; p < pages; ++p) {
            unsigned index = (page + p) * SSD1306_WIDTH + x + i;
            uint8_t value = glyph[p * width + i];

            /* 只在内容真的变了时才标脏。整屏重绘时绝大多数字符和上一帧一模一样，
             * 无条件标脏会让主页面每 200 ms 就把整屏推出去一次。 */
            if (oled->buffer[index] != value) {
                oled->buffer[index] = value;
                oled->dirty |= (uint8_t)(1u << (unsigned)(page + p));
            }
        }
    }
}

bool bsp_oled_text(bsp_oled_t *oled, unsigned x, unsigned page, const char *text, bool large)
{
    unsigned width = large ? SSD1306_LARGE_W : SSD1306_SMALL_W;
    unsigned pages = large ? 2u : 1u;
    unsigned length = (unsigned)strlen(text);
    unsigned i;

    /* 全有或全无：只画一半的行还不如一行都不画。 */
    if (x + length * width > SSD1306_WIDTH || page + pages > SSD1306_PAGES) {
        return false;
    }
    for (i = 0; i < length; ++i) {
        draw_char(oled, x + i * width, page, text[i], large);
    }
    return true;
}

bool bsp_oled_textf(bsp_oled_t *oled, unsigned x, unsigned page, bool large, const char *format,
                    ...)
{
    /* 能放下的最长一行是 21 个小号字符，另加结尾的结束符。 */
    char line[24];
    va_list args;
    va_start(args, format);
    (void)vsnprintf(line, sizeof(line), format, args);
    va_end(args);
    return bsp_oled_text(oled, x, page, line, large);
}
